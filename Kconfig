## Kconfig
```kconfig
menu "General"
	config WORKING_DIR
		string "Working directory"
		default "working_dir"
		help
			Write the working directory name

	choice GENERAL_TYPE
		prompt "General project type"
		default GENERAL_TYPE_BOARD
	config GENERAL_TYPE_BOARD
		bool "Project with board"
	config GENERAL_TYPE_BOARDLESS
		bool "Project without a board"
	endchoice

	config MAPFILE
		string "Pin mapping file"
		depends on GENERAL_TYPE_BOARD
		default ""
		help
			Write the pin mapping file name
endmenu

menu "BondMachine configuration"
	depends on GENERAL_TYPE_BOARD

	choice SELECT_PROJECT_TYPE
		prompt "Project type"
		default PROJECT_TYPE_BONDGO

		config PROJECT_TYPE_BONDGO
			bool "Bondgo source file"
		config PROJECT_TYPE_NEURALBOND
			bool "Neuralbond nn file"
		config PROJECT_TYPE_MELBOND
			bool "Melbond program file"
		config PROJECT_TYPE_BASM
			bool "Basm file"
	endchoice

	config SOURCE_GO
		string "source file"
		depends on PROJECT_TYPE_BONDGO
		default "test.go"
		help
			Write the source file name

	config SOURCE_NEURALBOND
		string "nn file"
		depends on PROJECT_TYPE_NEURALBOND
		default "test.json"
		help
			Write the neural network file name

	config SOURCE_MELBOND
		string "melbond file"
		depends on PROJECT_TYPE_MELBOND
		default "test.mel"
		help
			Write the melbond file name

	config SOURCE_BASM
		string "Select the basm file"
		depends on PROJECT_TYPE_BASM
		default "test.basm"
		help
			Write the basm file name

	config BASM_DEBUG
		bool "Show basm debug informations"
		depends on PROJECT_TYPE_BASM
		default n
		help
			Activate basm debug

endmenu

menu "Project configuration"
	depends on GENERAL_TYPE_BOARDLESS

	choice BOARDLESS_PROJECT
		prompt "Project type"
		default PROJECT_TYPE_MULTI

		config PROJECT_TYPE_MULTI
			bool "Multiple projects handler"
	endchoice

	config MULTI_TARGET
		depends on PROJECT_TYPE_MULTI
		string "Projects target"

	config MULTI_TYPE
		depends on PROJECT_TYPE_MULTI
		string "Projects type"
		default "templsim"

	config MULTI_TEMPLATEDIR
		depends on PROJECT_TYPE_MULTI
		string "Projects template dir"
		default "template"

	config MULTI_TEMPLATEDESC
		depends on PROJECT_TYPE_MULTI
		string "Projects template description JSON file"
		default "template.json"

endmenu

menu "Board and toolchain"
	depends on GENERAL_TYPE_BOARD
	choice SELECT_TOOLCHAIN
	    prompt "Toolchain"
	    default TOOLCHAIN_XILINX
	config TOOLCHAIN_XILINX
	    bool "AMD/Xilinx with Vivado"
	config TOOLCHAIN_ALTERA
	    bool "Intel/Altera with Quartus"
	config TOOLCHAIN_LATTICE
	    bool "Lattice with icestorm"
	endchoice

	choice SELECT_XILINX_BOARD
	    depends on TOOLCHAIN_XILINX
	    prompt "Xilinx board"
	config XILINX_BOARD_ZEDBOARD
	    bool "Zedboard"
	config XILINX_BOARD_BASYS3
	    bool "Basys3"
	config XILINX_BOARD_ZC702
	    bool "ZC702"
	config XILINX_BOARD_KC705
	    bool "KC705"
	config XILINX_BOARD_EBAZ4205
	    bool "Ebaz4205"
	endchoice

	choice SELECT_ALTERA_BOARD
	    depends on TOOLCHAIN_ALTERA
	    prompt "Altera board"
	config ALTERA_BOARD_DE0NANO
	    bool "DE0 Nano"
	config ALTERA_BOARD_MAX1000
	    bool "MAX1000"
	endchoice

	choice SELECT_LATTICE_BOARD
	    depends on TOOLCHAIN_LATTICE
	    prompt "Lattice board"
	config LATTICE_BOARD_ICE40LP1K
	    bool "ice40lp1k"
	config LATTICE_BOARD_ICEFUN
	    bool "icefun"	
	config LATTICE_BOARD_ICEBREAKER
	    bool "icebreaker"
	config LATTICE_BOARD_ICESUGARNANO
	    bool "icesugarnano"
	endchoice

endmenu

menu "External modules"
depends on GENERAL_TYPE_BOARD

config UART_SUPPORT
    bool "Activate UART support"
    default n
    help
      Activate UART support

config UART_MAPFILE
    string "UART PIN mapping file"
    depends on UART_SUPPORT
    default ""
    help
      UART PIM mapping file

endmenu

menu "Testing and debugging"
depends on GENERAL_TYPE_BOARD

config REGRESSION_TEST
    bool "Regression tests"
    default n
    help
      Activate regression test

config REGRESSION_TEST_HDL
    bool "Regression test on HDL"
    depends on REGRESSION_TEST
    default n
    help
      Activate regression test HDL

config HDL_REGRESSION
    string "HDL regression file"
    depends on REGRESSION_TEST_HDL
    default "bondmachine.sv"
    help
      Write the HDL regression file name

config REGRESSION_TEST_BM
    bool "Regression test on BM"
    depends on REGRESSION_TEST
    default n
    help
      Activate regression test BM

config BM_REGRESSION
    string "BM regression file"
    depends on REGRESSION_TEST_BM
    default "bondmachine.json"
    help
      Write the BM regression file name

config REGRESSION_TEST_SIM
    bool "Regression test on simulation"
    depends on REGRESSION_TEST
    default n
    help
      Activate regression test SIM

config SIM_REGRESSION
    string "SIM regression file"
    depends on REGRESSION_TEST_SIM
    default "bondmachine.sim"
    help
      Write the SIM regression file name    

endmenu
```
